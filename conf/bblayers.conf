## conf/bblayers.conf
```bitbake
BBLAYERS ?= " \
    ${PROJECT_ROOT}/poky/meta \
    ${PROJECT_ROOT}/poky/meta-poky \
    ${PROJECT_ROOT}/poky/meta-yocto-bsp \
    ${PROJECT_ROOT}/meta-rockchip \
    ${PROJECT_ROOT}/meta-arm/meta-arm \
    ${PROJECT_ROOT}/meta-arm/meta-arm-toolchain \
    "
```
